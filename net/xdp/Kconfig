## net/xdp/Kconfig
```kconfig
# SPDX-License-Identifier: GPL-2.0-only
config XDP_SOCKETS
	bool "XDP sockets"
	depends on BPF_SYSCALL
	default n
	help
	  XDP sockets allow high-performance packet exchange between
	  XDP programs and userspace applications. Applications use a
	  shared memory area and descriptor rings to receive and send
	  packets while an XSK map selects the destination socket.

config XDP_SOCKETS_DIAG
	tristate "XDP sockets: monitoring interface"
	depends on XDP_SOCKETS
	default n
	help
	  Support for PF_XDP sockets monitoring interface used by the ss tool.
	  If unsure, say Y.
```
